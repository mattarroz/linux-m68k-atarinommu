## arch/m68k/Kconfig.debug
```kconfig
menu "Kernel hacking"

source "lib/Kconfig.debug"

config EARLY_PRINTK
	bool "Early printk" if EMBEDDED
	depends on MVME16x
	default y
	help
          Write kernel log output directly to a serial port.

          This is useful for kernel debugging when your machine crashes very
          early before the console code is initialized.
          You should normally say N here, unless you want to debug such a crash.

endmenu
```
